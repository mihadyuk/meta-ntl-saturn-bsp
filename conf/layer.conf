## conf/layer.conf
```bitbake
# We have a conf and classes directory, add to BBPATH
BBPATH .= ":${LAYERDIR}"

# We have a recipes-* directories, add to BBFILES
BBFILES += "${LAYERDIR}/recipes-*/*/*.bb \
	${LAYERDIR}/recipes-*/*/*.bbappend"

BBFILE_COLLECTIONS += "ntl-saturn-bsp"
BBFILE_PATTERN_ntl-saturn-bsp = "^${LAYERDIR}/"
BBFILE_PRIORITY_ntl-saturn-bsp = "6"
```
